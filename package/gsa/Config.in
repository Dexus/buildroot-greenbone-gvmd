## package/gsa/Config.in
```kconfig
config BR2_PACKAGE_GREENBONE_GSA
    bool "gsa"
    depends on BR2_PACKAGE_GREENBONE_GVM_LIBS
    select BR2_PACKAGE_LIBXML2
    select BR2_PACKAGE_GNUTLS
    select BR2_PACKAGE_LIBMICROHTTPD
    select BR2_PACKAGE_LIBGCRYPT
    select BR2_PACKAGE_LIBGLIB2
    help
      Greenbone Security Assistant package
```

## package/gvm-libs/Config.in
```kconfig
config BR2_PACKAGE_GREENBONE_GVM_LIBS
    bool "gvm-libs"
    select BR2_PACKAGE_UTIL_LINUX
    select BR2_PACKAGE_UTIL_LINUX_LIBUUID
	  select BR2_PACKAGE_LIBGLIB2
	  select BR2_PACKAGE_LIBGPGME
    select BR2_PACKAGE_GNUTLS
    select BR2_PACKAGE_LIBSSH_LIBGCRYPT
    select BR2_PACKAGE_HIREDIS
    select BR2_PACKAGE_LIBPCAP
    select BR2_PACKAGE_LIBNET
    select BR2_PACKAGE_GREENBONE_GVMD
    select BR2_PACKAGE_GREENBONE_GSA
    select BR2_PACKAGE_GREENBONE_OPENVAS_SCANNER
    help
      gvm-libs package
```

## package/gvmd/Config.in
```kconfig
config BR2_PACKAGE_GREENBONE_GVMD
    bool "gvmd"
    depends on BR2_PACKAGE_GREENBONE_GVM_LIBS
    help
      GVMD package
```

## package/heimdal/Config.in.host
```kconfig
config BR2_PACKAGE_HOST_HEIMDAL
	bool "host heimdal"
	help
	  Heimdal Kerberos and Security Software
	  
	  https://github.com/heimdal/
```

## package/openvas-scanner/Config.in
```kconfig
config BR2_PACKAGE_GREENBONE_OPENVAS_SCANNER
    bool "openvas-scanner"
    depends on BR2_PACKAGE_GREENBONE_GVM_LIBS
    help
      openvas-scanner package
```

## package/openvas-smb/Config.in
```kconfig
config BR2_PACKAGE_GREENBONE_OPENVAS_SMB
    bool "openvas-smb"
    depends on BR2_PACKAGE_GREENBONE_OPENVAS_SCANNER
    help
      openvas-smb package
```

## package/perl-xml-twig/Config.in
```kconfig
config BR2_PACKAGE_PERL_XML_TWIG
	bool "perl-xml-twig"
	depends on !BR2_STATIC_LIBS
	select BR2_PACKAGE_PERL_XML_PARSER # runtime
	help
	  XML, The Perl Way.

	  https://metacpan.org/release/XML-Twig

comment "perl-xml-twig needs a toolchain w/ dynamic library"
	depends on BR2_STATIC_LIBS
```

## package/python-gvm-tools/Config.in
```kconfig
config BR2_PACKAGE_PYTHON_GVM_TOOLS
	bool "python-gvm-tools"
	select BR2_PACKAGE_PYTHON_GVM # runtime
	help
	  Tools to control a GSM/GVM over GMP or OSP.

	  https://github.com/greenbone/gvm-tools/
```

## package/python-gvm/Config.in
```kconfig
config BR2_PACKAGE_PYTHON_GVM
	bool "python-gvm"
	select BR2_PACKAGE_PYTHON_DEFUSEDXML # runtime
	select BR2_PACKAGE_PYTHON_LXML # runtime
	select BR2_PACKAGE_PYTHON_PARAMIKO # runtime
	help
	  Library to communicate with remote servers over GMP or OSP.

	  https://github.com/greenbone/python-gvm
```

## package/python-ospd-openvas/Config.in
```kconfig
config BR2_PACKAGE_PYTHON_OSPD_OPENVAS
	bool "python-ospd-openvas"
	select BR2_PACKAGE_PYTHON_OSPD # runtime
	select BR2_PACKAGE_PYTHON_PACKAGING # runtime
	select BR2_PACKAGE_PYTHON_PSUTIL # runtime
	select BR2_PACKAGE_PYTHON_REDIS # runtime
	help
	  ospd based scanner for openvas.

	  https://github.com/greenbone/ospd-openvas
```

## package/python-ospd/Config.in
```kconfig
config BR2_PACKAGE_PYTHON_OSPD
	bool "python-ospd"
	select BR2_PACKAGE_PYTHON_DEFUSEDXML # runtime
	select BR2_PACKAGE_PYTHON_DEPRECATED # runtime
	select BR2_PACKAGE_PYTHON_LXML # runtime
	select BR2_PACKAGE_PYTHON_PARAMIKO # runtime
	select BR2_PACKAGE_PYTHON_PSUTIL # runtime
	help
	  OSPD is a base for scanner wrappers which share the same
	  communication protocol: OSP (Open Scanner Protocol).

	  https://github.com/greenbone/ospd
```
